;change to current directory
&workingdir=OS.PPD()
cd "&workingdir"

SYStem.Down
SYStem.CPU XC2287M-104F
sys.u


; Erase Flash. Note: Without bootloader
flash.erase 0xC10000--0xCCFFFF


; Flash program
FLASH.Auto 0xC10000--0xCCFFFF
Data.LOAD.auto .\build\main.hex /WORD
Data.LOAD.auto .\build\main.elf /nocode
FLASH.Auto OFF

; Add reset toolbar
menu.REPROGRAM "..\..\bsp\toolset\toolbar.men"

